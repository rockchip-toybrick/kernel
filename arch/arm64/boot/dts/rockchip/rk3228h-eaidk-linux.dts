/*
 * Copyright (c) 2017 Fuzhou Rockchip Electronics Co., Ltd
 *
 * SPDX-License-Identifier: (GPL-2.0+ OR MIT)
 */

/dts-v1/;
#include "rk3228h-eaidk.dtsi"

/ {
	compatible = "rockchip,rk3228h-eaidk-linux", "rockchip,rk3228h";
};

