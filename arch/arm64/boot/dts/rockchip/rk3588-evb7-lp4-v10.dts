// SPDX-License-Identifier: (GPL-2.0+ OR MIT)
/*
 * Copyright (c) 2021 Rockchip Electronics Co., Ltd.
 *
 */

/dts-v1/;

#include "rk3588-evb7-lp4.dtsi"
#include "rk3588-evb7-imx415.dtsi"
#include "rk3588-android.dtsi"

/ {
	model = "Rockchip RK3588 EVB7 LP4 V10 Board";
	compatible = "rockchip,rk3588-evb7-lp4-v10", "rockchip,rk3588";
};

&rockchip_suspend {
	status = "okay";
	rockchip,sleep-mode-config = <
		(0
		| RKPM_SLP_ARMOFF_LOGOFF
		| RKPM_SLP_PMU_PMUALIVE_32K
		| RKPM_SLP_PMU_DIS_OSC
		| RKPM_SLP_32K_EXT
		| RKPM_SLP_SINGLE_PMIC_TC
		| RKPM_SLP_PMIC_LP
		)
	>;
};
