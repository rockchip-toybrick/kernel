// SPDX-License-Identifier: (GPL-2.0+ OR MIT)
/*
 * Copyright (c) 2020 Rockchip Electronics Co., Ltd.
 *
 */

#include "rk3568m-vehicle-evb-v10.dtsi"
#include "rk3568m-vehicle-evb-maxim-max96712-dphy0.dtsi"
#include "rk3568-android.dtsi"
