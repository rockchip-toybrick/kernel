## drivers/media/platform/rockchip/hdmirx/Kconfig
```kconfig
# SPDX-License-Identifier: GPL-2.0

config VIDEO_ROCKCHIP_HDMIRX_CLASS
	tristate "Rockchip HDMI Receiver Devices Class Support"
	help
	  There are many hdmirx devices in Rockchip SOCs, eg.
	  rkhdmirx rk628 lut6911 it6616
	  This driver create a class for those hdmirx devices
	  And hdmirx drivers can add hdmirx properties for those
	  hdmirx devices

	  To compile this driver as a module, choose M here.
```

## drivers/media/platform/rockchip/isp1/Kconfig
```kconfig
# SPDX-License-Identifier: GPL-2.0
config VIDEO_ROCKCHIP_ISP1
	tristate "Rockchip Image Signal Processing v1 Unit driver"
	depends on VIDEO_V4L2 && VIDEO_V4L2_SUBDEV_API
	depends on ARCH_ROCKCHIP || COMPILE_TEST
	select VIDEOBUF2_DMA_CONTIG
	select VIDEOBUF2_VMALLOC
	select V4L2_FWNODE
	select PHY_ROCKCHIP_MIPI_RX
	default n
	help
	  Support for ISP1 on the rockchip SoC.

config VIDEO_ROCKCHIP_ISP1_SPLANE
	tristate "Rockchip Image Signal Processing v1 Unit driver with splane"
	depends on VIDEO_ROCKCHIP_ISP1
	default n
	help
	  ISP1 switch from mplane to splane on the rockchip SoC.
```

## drivers/media/platform/toybrick/Kconfig
```kconfig
config VIDEO_TOYBRICK_RTSP
	tristate "Toybrick V4L2-RTSP Virtual Driver"
	depends on MMU
	select VIDEOBUF_GEN
	select VIDEOBUF_DMA_CONTIG
	default n
	---help---
	  V4L2 RTSP Virtual capture and output driver support for toybrick boards.
```

## drivers/misc/extbrd/Kconfig
```kconfig
comment "ARM EAIDK EXTIO Borad Driver"

config EAIDK_EXTBRD
	tristate "ARM EAIDK ExtIO Borad support"
	default n
	help
		ARM EAIDK EXTIO Board Driver. Say Y when you want to support.
```
